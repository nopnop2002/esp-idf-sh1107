## main/Kconfig.projbuild
```kconfig
menu "SH1107 Configuration"

	choice INTERFACE
		prompt "Interface"
		default I2C_INTERFACE
		help
			Select Interface.
		config I2C_INTERFACE
			bool "I2C Interface"
			help
				I2C Interface.
		config SPI_INTERFACE
			bool "SPI Interface"
			help
				SPI Interface.
	endchoice

	config SCL_GPIO
		depends on I2C_INTERFACE
		int "SCL GPIO number"
		range 0 46
		default 22 if IDF_TARGET_ESP32
		default 12 if IDF_TARGET_ESP32S2
		help
			GPIO number (IOxx) to I2C SCL.
			Some GPIOs are used for other purposes (flash connections, etc.) and cannot be used to I2C.
			On the ESP32, GPIOs 35-39 are input-only so cannot be used as outputs.
			On the ESP32-S2, GPIO 46 is input-only so cannot be used as outputs.

	config SDA_GPIO
		depends on I2C_INTERFACE
		int "SDA GPIO number"
		range 0 46
		default 21 if IDF_TARGET_ESP32
		default 11 if IDF_TARGET_ESP32S2
		help
			GPIO number (IOxx) to I2C SDA.
			Some GPIOs are used for other purposes (flash connections, etc.) and cannot be used to I2C.
			On the ESP32, GPIOs 35-39 are input-only so cannot be used as outputs.
			On the ESP32-S2, GPIO 46 is input-only so cannot be used as outputs.


	config I2C_RESET_GPIO
		depends on I2C_INTERFACE
		int "RESET GPIO number"
		range -1 46
		default -1
		help
			GPIO number (IOxx) to RESET.
			When it is -1, RESET isn't performed.
			Some GPIOs are used for other purposes (flash connections, etc.) and cannot be used to Reset.
			On the ESP32, GPIOs 35-39 are input-only so cannot be used as outputs.
			On the ESP32-S2, GPIO 46 is input-only so cannot be used as outputs.

	config SPI_RESET_GPIO
		depends on SPI_INTERFACE
		int "RESET GPIO number"
		range -1 46
		default 33
		help
			GPIO number (IOxx) to RESET.
			When it is -1, RESET isn't performed.
			Some GPIOs are used for other purposes (flash connections, etc.) and cannot be used to Reset.
			On the ESP32, GPIOs 35-39 are input-only so cannot be used as outputs.
			On the ESP32-S2, GPIO 46 is input-only so cannot be used as outputs.


	config MOSI_GPIO
		depends on SPI_INTERFACE
		int "MOSI GPIO number"
		range 0 46
		default 23 if IDF_TARGET_ESP32
		default 35 if IDF_TARGET_ESP32S2
		help
			GPIO number (IOxx) to SPI MOSI.
			Some GPIOs are used for other purposes (flash connections, etc.) and cannot be used to DC.
			On the ESP32, GPIOs 35-39 are input-only so cannot be used as outputs.
			On the ESP32-S2, GPIO 46 is input-only so cannot be used as outputs.

	config SCLK_GPIO
		depends on SPI_INTERFACE
		int "SCLK GPIO number"
		range 0 46
		default 18 if IDF_TARGET_ESP32
		default 36 if IDF_TARGET_ESP32S2
		help
			GPIO number (IOxx) to SPI SCLK.
			Some GPIOs are used for other purposes (flash connections, etc.) and cannot be used to DC.
			On the ESP32, GPIOs 35-39 are input-only so cannot be used as outputs.
			On the ESP32-S2, GPIO 46 is input-only so cannot be used as outputs.

	config CS_GPIO
		depends on SPI_INTERFACE
		int "CS GPIO number"
		range 0 46
		default 14 if IDF_TARGET_ESP32
		default 34 if IDF_TARGET_ESP32S2
		help
			GPIO number (IOxx) to SPI CS.
			Some GPIOs are used for other purposes (flash connections, etc.) and cannot be used to CS.
			On the ESP32, GPIOs 35-39 are input-only so cannot be used as outputs.
			On the ESP32-S2, GPIO 46 is input-only so cannot be used as outputs.

	config DC_GPIO
		depends on SPI_INTERFACE
		int "DC GPIO number"
		range 0 46
		default 27
		help
			GPIO number (IOxx) to SPI DC.
			Some GPIOs are used for other purposes (flash connections, etc.) and cannot be used to DC.
			On the ESP32, GPIOs 35-39 are input-only so cannot be used as outputs.
			On the ESP32-S2, GPIO 46 is input-only so cannot be used as outputs.


endmenu
```
